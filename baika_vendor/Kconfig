## baika_vendor/Kconfig
```kconfig
config OPLUS_FEATURE_GAME_OPT
	tristate "Oplus game optimization"
	default m

config OPLUS_FEATURE_GEAS_CPU
	tristate "Oplus GEAS CPU"
	depends on OPLUS_FEATURE_GAME_OPT
	default m

config OPLUS_FEATURE_GEAS
	tristate "Oplus GEAS system"
	depends on OPLUS_FEATURE_GAME_OPT
	default m

config OPLUS_FEATURE_GEAS_FDRIVE
	tristate "Oplus GEAS frame drive"
	depends on OPLUS_FEATURE_GEAS
	default m

config OPLUS_FEATURE_GEAS_BWMON
	tristate "Oplus GEAS bandwidth monitor"
	depends on OPLUS_FEATURE_GEAS
	default m

config OPLUS_FEATURE_GEAS_GPU
	tristate "Oplus GEAS GPU"
	depends on OPLUS_FEATURE_GEAS
	default m

config OPLUS_FEATURE_GEAS_EMI
	tristate "Oplus GEAS EMI"
	depends on OPLUS_FEATURE_GEAS
	default m

config OPLUS_FEATURE_GEAS_MEMLAT
	tristate "Oplus GEAS memory latency"
	depends on OPLUS_FEATURE_GEAS
	default m

config OPLUS_FEATURE_GEAS_NPU
	tristate "Oplus GEAS NPU"
	depends on OPLUS_FEATURE_GEAS
	default m
```

## baika_vendor/oplus/kernel/cpu/game_opt/Kconfig
```kconfig
# SPDX-License-Identifier: GPL-2.0-only

config OPLUS_FEATURE_GAME_OPT
	tristate "Oplus game optimization"
	depends on ARM64 && CPU_FREQ && ENERGY_MODEL && ANDROID_VENDOR_HOOKS
	default m
	help
	  Enable Oplus game scheduling and frame optimization.
```

## baika_vendor/oplus/kernel/cpu/geas/cpu/Kconfig
```kconfig
# SPDX-License-Identifier: GPL-2.0-only

config OPLUS_FEATURE_GEAS_CPU
	tristate "GEAS CPU"
	depends on OPLUS_FEATURE_GAME_OPT
	default m
	help
	  Enable Game Energy Aware Scheduling CPU control.
```

## baika_vendor/oplus/kernel/cpu/geas/system/Kconfig
```kconfig
# SPDX-License-Identifier: GPL-2.0-only

config OPLUS_FEATURE_GEAS
	tristate "GEAS system"
	depends on OPLUS_FEATURE_GAME_OPT
	default m
	help
	  Enable Game Energy Aware Scheduling system controls.

config OPLUS_FEATURE_GEAS_EMI
	tristate "GEAS EMI"
	depends on OPLUS_FEATURE_GEAS && ARCH_MEDIATEK
	default n

config OPLUS_FEATURE_GEAS_FDRIVE
	tristate "GEAS frame drive"
	depends on OPLUS_FEATURE_GEAS
	default n

config OPLUS_FEATURE_GEAS_BWMON
	tristate "GEAS bandwidth monitor"
	depends on OPLUS_FEATURE_GEAS
	default n

config OPLUS_FEATURE_GEAS_GPU
	tristate "GEAS GPU"
	depends on OPLUS_FEATURE_GEAS
	default n

config OPLUS_FEATURE_GEAS_MEMLAT
	tristate "GEAS memory latency"
	depends on OPLUS_FEATURE_GEAS
	default n

config OPLUS_FEATURE_GEAS_NPU
	tristate "GEAS NPU"
	depends on OPLUS_FEATURE_GEAS
	default n
```
